/dts-v1/;

/ {
	compatible = "brcm,bcm2835";

	fragment@0 {
		target = <0xffffffff>;

		__overlay__ {
			status = "disabled";
		};
	};

	fragment@1 {
		target = <0xffffffff>;

		__overlay__ {
			#address-cells = <0x01>;
			#size-cells = <0x00>;
			status = "okay";

			cxd2880@0 {
				compatible = "sony,cxd2880";
				reg = <0x00>;
				spi-max-frequency = <0x2faf080>;
				status = "okay";
			};
		};
	};

	__fixups__ {
		spidev0 = "/fragment@0:target:0";
		spi0 = "/fragment@1:target:0";
	};
};
